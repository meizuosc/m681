## drivers/misc/mediatek/mtkpasr/Kconfig
```kconfig
config MTKPASR
	bool "MTK proprietary PASR mechanism"
	depends on !MTK_SVP && SYSFS && ZSMALLOC
	select LZO_COMPRESS
	select LZO_DECOMPRESS
	default n
	help
	  Mediatek PASR mechanism

config MTKPASR_DEBUG
	bool "MTK proprietary PASR debug support"
	depends on MTKPASR
	default n
	help
	  This option adds additional debugging code to MTK PASR

config MTKPASR_NO_LASTBANK
	bool "Modem/TEE/Others occupy the last bank"
	depends on MTKPASR
	default n
```

## drivers/misc/mediatek/mu3d/Kconfig
```kconfig
#
# MediaTek USB 3.0 Controller Driver
#

config USBIF_COMPLIANCE
        tristate "MediaTek MUSB U3 USBIF COMPLIANCE"
        default n

config USB_MU3D_PIO_ONLY
	tristate "MediaTek MUSB Gadget support EP0 PIO mode"
	default n

config USB_MU3D_DEFAULT_U2_MODE
	tristate "MediaTek SSUSB default in USB High-Speed Mode"
	default n

config USB_MU3D_ONLY_U2_MODE
	tristate "MediaTek SSUSB default in USB High-Speed Mode"
	default n
	help
	  Support only U2 mode.

config MTK_SIB_USB_SWITCH
	bool "MediaTek USB and SIB switch"
	help
	  Support share USB pin to SIB function.

config USB_MU3D_DRV
	tristate "MediaTek MUSB Gadget support"
	default n

config USB_MU3D_DVT
	tristate "MediaTek MUSB Gadget support"
	default n
```

## drivers/misc/mediatek/usb_typec/Kconfig
```kconfig
#
# MediaTek USB USB TYPEC Driver
#

config MTK_TYPEC_SWITCH
        bool "MediaTek USB TYPE-C Driver"
        default n
	---help---
	  Enables support usb type-c.
	  If unsure, say N.

config MTK_TYPEC_SWITCH_FUSB302
	bool "MediaTek USB TYPE-C Driver with external solution (FUSB302)"
	default n
	---help---
	  Enables support usb type-c and FUSB302.
	  If unsure, say N.
```
