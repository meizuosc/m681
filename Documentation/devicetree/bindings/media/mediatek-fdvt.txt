## Documentation/devicetree/bindings/media/mediatek-fdvt.txt
```
* Mediatek Camera FDVT Driver

This document describes the binding for the MediaTek camera FDVT.

Required properties:
- compatible: "mediatek,mt6735-fdvt" for MT6735 SoCs
- interrupts: IRQ for camera isp in SOC
- reg: The base address of the isp register
- clocks: device clocks
- clock-name: Should be the names of the clocks
   - "CG_SCP_SYS_DIS" for display CMOS
   - "CG_SCP_SYS_ISP" for isp CMOS
   - "CG_DISP0_SMI_COMMON" for DISP SMI
   - "CG_IMG_IMAGE_FD" for camera SMI


Example:

		fdvt@0x1500B000 {
			compatible = "mediatek,mt6735-fdvt";
			reg = <0x1500B000 0x1000>;
			interrupts = <GIC_SPI 208 IRQ_TYPE_LEVEL_LOW>;
			clocks = <&scpsys SCP_SYS_DIS>,
					<&scpsys SCP_SYS_ISP>,
					<&mmsys MM_DISP0_SMI_COMMON>,
					<&imgsys IMG_IMAGE_FD>;
			clock-names = "FD-SCP_SYS_DIS",
						"FD-SCP_SYS_ISP",
						"FD-MM_DISP0_SMI_COMMON",
						"FD-IMG_IMAGE_FD";
		};
```

## Documentation/devicetree/bindings/media/mediatek-ispsys.txt
```
* Mediatek Camera ISP Driver

This document describes the binding for the MediaTek camera ISP.

Required properties:
- compatible: "mediatek,mt6735-ispsys" for MT6735 SoCs
- interrupts: IRQ for camera isp in SOC
- reg: The base address of the isp register
- clocks: device clocks
- clock-name: Should be the names of the clocks
   - "CG_SCP_SYS_DIS" for display CMOS
   - "CG_SCP_SYS_ISP" for isp CMOS
   - "CG_DISP0_SMI_COMMON" for DISP SMI
   - "CG_IMAGE_CAM_SMI" for camera SMI
   - "CG_IMAGE_CAM_CAM" for camera
   - "CG_IMAGE_SEN_TG" for TG
   - "CG_IMAGE_SEN_CAM" for sensor
   - "CG_IMAGE_CAM_SV" for camsv
   - "CG_IMAGE_LARB2_SMI" for larb2 SMI

Example:

	ispsys@15000000 {
		compatible = "mediatek,mt6735-ispsys";
		reg = <0x15004000 0x9000>,  /*ISP_ADDR      */
			<0x1500D000 0x1000>,  /*INNER_ISP_ADDR      */
			<0x15000000 0x10000>,  /*IMGSYS_CONFIG_ADDR      */
			<0x10215000 0x3000>,  /*MIPI_ANA_ADDR      */
			<0x10211000 0x1000>;  /*GPIO_ADDR      */

		interrupts = <GIC_SPI 183 IRQ_TYPE_LEVEL_LOW>, /* CAM0 */
			<GIC_SPI 184 IRQ_TYPE_LEVEL_LOW>, /* CAM1 */
			<GIC_SPI 185 IRQ_TYPE_LEVEL_LOW>, /* CAM2 */
			<GIC_SPI 206 IRQ_TYPE_LEVEL_LOW>, /* CAMSV0 */
			<GIC_SPI 207 IRQ_TYPE_LEVEL_LOW>; /* CAMSV1 */

		clocks = <&scpsys SCP_SYS_DIS>,
			<&scpsys SCP_SYS_ISP>,
			<&mmsys MM_DISP0_SMI_COMMON>,
			<&imgsys IMG_IMAGE_CAM_SMI>,
			<&imgsys IMG_IMAGE_CAM_CAM>,
			<&imgsys IMG_IMAGE_SEN_TG>,
			<&imgsys IMG_IMAGE_SEN_CAM>,
			<&imgsys IMG_IMAGE_CAM_SV>,
			<&imgsys IMG_IMAGE_LARB2_SMI>;

		clock-names = "CG_SCP_SYS_DIS",
			"CG_SCP_SYS_ISP",
			"CG_DISP0_SMI_COMMON",
			"CG_IMAGE_CAM_SMI",
			"CG_IMAGE_CAM_CAM",
			"CG_IMAGE_SEN_TG",
			"CG_IMAGE_SEN_CAM",
			"CG_IMAGE_CAM_SV",
			"CG_IMAGE_LARB2_SMI";
	};
```

## Documentation/devicetree/bindings/power/mediatek-ptp_fsm_v1.txt
```
TWL BCI (Battery Charger Interface)

Required properties:
- compatible:
  - "mediatek,ptp_fsm_v1"
- reg: The base address ptp register bank
- interrupts: Should contain PTP interrupt.

Examples:

ptp_fsm@1100b000 {
	compatible = "mediatek,ptp_fsm_v1";
	reg = <0x1100B000 0x1000>;
	interrupts = <GIC_SPI 125 IRQ_TYPE_LEVEL_LOW>;
};
```

## drivers/input/touchscreen/mediatek/GT1151/Kconfig
```kconfig
#
# Touchscreen driver configuration
#
if TOUCHSCREEN_MTK_GT1151

config GT1151_FIRMWARE
	string "GT1151 for Mediatek firmware"

config GT1151_CONFIG
	string "GT1151 for Mediatek config"

config GT1151_ALLOW_DOWNGRADE
	bool "GT1151 for Mediatek firmware downgrade"
	default n
	help
	Say Y here if you allow touch firmware to downgrade.

	If unsure, say N.

endif
```

## drivers/input/touchscreen/mediatek/Kconfig
```kconfig
#
# Touchscreen driver configuration
#
menuconfig INPUT_TOUCHSCREEN
	bool "Touchscreens"
	help
	  Say Y here, and a list of supported touchscreens will be displayed.
	  This option doesn't affect the kernel.

	  If unsure, say Y.

if INPUT_TOUCHSCREEN

source "drivers/input/touchscreen/mediatek/GT1151/Kconfig"

endif
```

## drivers/irqchip/Kconfig
```kconfig
config IRQCHIP
	def_bool y
	depends on OF_IRQ

config ARM_GIC
	bool
	select IRQ_DOMAIN
	select MULTI_IRQ_HANDLER

config GIC_NON_BANKED
	bool

config ARM_VIC
	bool
	select IRQ_DOMAIN
	select MULTI_IRQ_HANDLER

config ARM_VIC_NR
	int
	default 4 if ARCH_S5PV210
	default 3 if ARCH_S5PC100
	default 2
	depends on ARM_VIC
	help
	  The maximum number of VICs available in the system, for
	  power management.

config RENESAS_INTC_IRQPIN
	bool
	select IRQ_DOMAIN

config RENESAS_IRQC
	bool
	select IRQ_DOMAIN

config VERSATILE_FPGA_IRQ
	bool
	select IRQ_DOMAIN

config VERSATILE_FPGA_IRQ_NR
       int
       default 4
       depends on VERSATILE_FPGA_IRQ

config MTK_GIC
       def_bool y if ARM64 && MEDIATEK_SOLUTION
       select IRQ_DOMAIN
       select MULTI_IRQ_HANDLER

config MTK_IRQ
       def_bool y if !MTK_GIC

config MTK_EIC
       bool
       select IRQ_DOMAIN

config MTK_EIC_HISTORY_DUMP
       bool "Enable MTK EIC HISTORY Debugger"
       def_bool n
       depends on MTK_EIC
       help
         This option is used to collect last eint interupts and its property before WDT TIMEOUT.
         with thie option, we could know which eint interrupt is triggered too often to cause system
         watchdog timeout.

config MTK_IRQ_NEW_DESIGN
	bool
	select MTK_GIC

config MTK_IRQ_NEW_DESIGN_DEBUG
	bool
	select MTK_GIC
	select MTK_IRQ_NEW_DESIGN
```

## drivers/misc/fingerprint/gfx1xm/Kconfig
```kconfig
#
# Tablet driver configuration
#

config INPUT_GFX1XM_SPI
       bool "gfx1xm driver"
       help
          MEIZU BSP .
```

## drivers/misc/mediatek/accelerometer/mc6470_acc/Kconfig
```kconfig
config MTK_MC6470_ACC
	bool "mc6470 acc(acc+mag) for MediaTek package"
	default n
```

## drivers/misc/mediatek/debug_latch/Kconfig
```kconfig
config MTK_LASTBUS
	bool "Enable MTK LASTBUS LATCH"
	default n
	help
	  CONFIG_MTK_LASTBUS

config MTK_DEBUG_LATCH
	bool "Enable MTK DEBUG LATCH"
	default n
	help
	  CONFIG_MTK_DEBUG_LATCH
```

## drivers/misc/mediatek/dramc/Kconfig
```kconfig
config MTK_DRAMC
	bool "Enable MTK DRAMC Driver"
	default y
	help
	  This enable MTK dramc driver DFS dummy read,complex R/W..etc.
```

## drivers/misc/mediatek/fingerprint/Kconfig
```kconfig
config FINGERPRINT_GOODIX_GF616
  bool FINGERPRINT_GOODIX_GF616
  default n
  help
    Goodix Fingerprint chip GF616/GF516/GF316/GF318

config FINGERPRINT_GOODIX_GF516M
  bool FINGERPRINT_GOODIX_GF516M
  default y
  help
    Goodix Fingerprint chip GF316M/GF516M/GF616M/GF318M
```

## drivers/misc/mediatek/gpu/Kconfig
```kconfig
config MTK_GPU_SUPPORT
  bool CONFIG_MTK_GPU_SUPPORT
  default n
  help
    CONFIG_MTK_GPU_SUPPORT define if the gpu driver should be built in or not

config MTK_GPU_COMMON_DVFS_SUPPORT
  bool CONFIG_MTK_GPU_COMMON_DVFS_SUPPORT
  default n
  help
    CONFIG_MTK_GPU_COMMON_DVFS_SUPPORT define to use COMMON DVFS
```

## drivers/misc/mediatek/log_store/Kconfig
```kconfig
config MTK_DRAM_LOG_STORE
	default n
	bool "mtk DRAM log store"

config MTK_DRAM_LOG_STORE_ADDR
	hex "DRAM log store address(use SRAM)"
	default 0
	depends on MTK_DRAM_LOG_STORE

config MTK_DRAM_LOG_STORE_SIZE
	hex "DRAM log store size(use SRAM)"
	default 0
	depends on MTK_DRAM_LOG_STORE
```
